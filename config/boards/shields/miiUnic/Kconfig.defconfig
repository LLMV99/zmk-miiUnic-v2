## config/boards/shields/miiUnic/Kconfig.defconfig
```kconfig
if SHIELD_MIIUNIC_LEFT

config ZMK_KEYBOARD_NAME
    default "miiUnic"

config ZMK_SPLIT_ROLE_CENTRAL
    default y
endif

if SHIELD_MIIUNIC_LEFT || SHIELD_MIIUNIC_RIGHT

config ZMK_SPLIT
    default y

endif
```

## config/boards/shields/miiUnic/Kconfig.shield
```kconfig
config SHIELD_MIIUNIC_LEFT
    def_bool $(shields_list_contains,miiUnic_left)

config SHIELD_MIIUNIC_RIGHT
    def_bool $(shields_list_contains,miiUnic_right)
```
